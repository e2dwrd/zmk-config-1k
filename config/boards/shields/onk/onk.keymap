/*
 * Copyright (c) 2022 The ZMK Contributors
 *
 * SPDX-License-Identifier: MIT
 */

#include <behaviors.dtsi>
#include <dt-bindings/zmk/keys.h>
#include <dt-bindings/zmk/bt.h>
 
/ {
    keymap {
        compatible = "zmk,keymap";
 
        default_layer {
            bindings = <
                &kp Z
                &kp X
                &kp C
            >;
        };
    };
};

#include <behaviors.dtsi>
#include <dt-bindings/zmk/keys.h>
#include <dt-bindings/zmk/bt.h>

/ {
    keymap {
        compatible = "zmk,keymap";

        default_layer {

            bindings = <
                &kp E 
                &bt BT_SEL 0
                &bt BT_CLR

               >;
        
            };

       

    };
};
